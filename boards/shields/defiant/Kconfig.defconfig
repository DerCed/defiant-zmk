## boards/shields/defiant/Kconfig.defconfig
```kconfig
if DEFIANT_RIGHT

config ZMK_KEYBOARD_NAME
    default "DefiantCed"

config ZMK_SPLIT_ROLE_CENTRAL
    default y

endif

if DEFIANT_LEFT || DEFIANT_RIGHT

config ZMK_SPLIT
    default y

config ZMK_KEYBOARD_NAME
    default "Defiant_ced"


endif
```
